## firmware/main/Kconfig.projbuild
```kconfig
menu "Terra"
    config TERRA_INPUT_DIAGNOSTICS
        bool "Log raw button transitions for wiring/debounce diagnosis"
        default n
        help
            Temporary diagnostic: logs GPIO press/release edges and durations.
            Disable after capture; UART logging can affect sampling of noisy contacts.
    config TERRA_USB_PROBE
        bool "Enable read-only USB sector diagnostics (N0)"
        default n
        help
            Requires UART console and verified USB host power wiring. Reads only
            LBA0 and the first sector of up to four primary MBR partitions.
            Does not mount FAT/NTFS, write disks, or serve files over the network.
endmenu
```

## firmware/sdkconfig.defaults
```kconfig
CONFIG_IDF_TARGET="esp32s3"
CONFIG_ESPTOOLPY_FLASHSIZE_16MB=y
CONFIG_ESPTOOLPY_FLASHMODE_QIO=y
CONFIG_ESPTOOLPY_FLASHFREQ_80M=y
CONFIG_SPIRAM=y
CONFIG_SPIRAM_MODE_OCT=y
CONFIG_SPIRAM_SPEED_80M=y
CONFIG_SPIRAM_BOOT_INIT=y
CONFIG_SPIRAM_MEMTEST=y
CONFIG_SPIRAM_USE_MALLOC=y
CONFIG_PARTITION_TABLE_CUSTOM=y
CONFIG_PARTITION_TABLE_CUSTOM_FILENAME="partitions.csv"
CONFIG_ESP_CONSOLE_USB_SERIAL_JTAG=y
CONFIG_FREERTOS_HZ=1000
# display_render() runs an LVGL refresh on the main task; 3584 overflowed on hardware.
CONFIG_ESP_MAIN_TASK_STACK_SIZE=8192
CONFIG_LV_COLOR_DEPTH_16=y
CONFIG_LV_FONT_MONTSERRAT_14=y
CONFIG_LV_FONT_MONTSERRAT_18=y
CONFIG_LV_FONT_MONTSERRAT_28=y
# CONFIG_LV_USE_DEMO_WIDGETS is not set
# CONFIG_LV_BUILD_EXAMPLES is not set
# CONFIG_LV_BUILD_DEMOS is not set
```
